/ {
	chosen {
		zmk,kscan = &kscan0;
	};

	kscan0: kscan_0 {
		compatible = "zmk,kscan-gpio-matrix";
		label  = "KSCAN";
		diode-direction = "col2row";

		col-gpios
			= <&gpio0 29 GPIO_ACTIVE_HIGH> 
			, <&gpio0 31 GPIO_ACTIVE_HIGH>
			, <&gpio0 30  GPIO_ACTIVE_HIGH>
			, <&gpio0 6 GPIO_ACTIVE_HIGH>
			;

			
		row-gpios
			= <&gpio1 11 (GPIO_ACTIVE_HIGH | GPIO_PULL_DOWN)>
			, <&gpio0 28 (GPIO_ACTIVE_HIGH | GPIO_PULL_DOWN)>
			, <&gpio1 13 (GPIO_ACTIVE_HIGH | GPIO_PULL_DOWN)>
			, <&gpio0 2 (GPIO_ACTIVE_HIGH | GPIO_PULL_DOWN)>
            , <&gpio0 8 (GPIO_ACTIVE_HIGH | GPIO_PULL_DOWN)>
			;
	};
};
